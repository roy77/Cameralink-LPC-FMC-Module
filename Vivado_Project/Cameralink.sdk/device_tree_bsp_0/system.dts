/*
 * CAUTION: This file is automatically generated by Xilinx.
 * Version:  
 * Today is: Wed Aug 13 12:53:54 2014
*/

/dts-v1/;
/include/ "ps.dtsi"
/include/ "pl.dtsi"
/{
	chosen {
		bootargs = "console=ttyPS0,115200";
		linux,stdout-path = &ps7_uart_1;
	} ;
	aliases {
		ethernet0 = &ps7_ethernet_0;
		serial0 = &ps7_uart_1;
		spi0 = &ps7_qspi_0;
	} ;
	ps7_ddr_0: memory@00100000 {
		device_type = "memory";
		reg = <0x0 0x20000000>;
	} ;
};
